## client_example/sdkconfig.defaults
```kconfig
# Minimal config for client
CONFIG_ESP_TASK_WDT_TIMEOUT_S=30
CONFIG_LOG_DEFAULT_LEVEL_INFO=y
CONFIG_FREERTOS_HZ=100
```

## sdkconfig.defaults
```kconfig
# Watchdog
CONFIG_ESP_TASK_WDT_TIMEOUT_S=30

# Log level
CONFIG_LOG_DEFAULT_LEVEL_INFO=y

# FreeRTOS tick rate - 100Hz is plenty for minute-level accuracy
CONFIG_FREERTOS_HZ=100

# SNTP — 4 upstream servers, poll every 6 hours
CONFIG_LWIP_SNTP_MAX_SERVERS=4
CONFIG_LWIP_SNTP_UPDATE_DELAY=21600000
```
